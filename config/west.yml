## config/west.yml
```yaml
manifest:
  remotes:
    - name: zmkfirmware
      url-base: https://github.com/zmkfirmware
#    - name: ftc
#      url-base: https://github.com/ftc           
    - name: caksoylar
      url-base: https://github.com/caksoylar     
#    - name: infused-kim
#      url-base: https://github.com/infused-kim
  projects:
    - name: zmk
      remote: caksoylar
      revision: split-encoder
      import: app/west.yml  
#    - name: zmk
#      remote: ftc
#      revision: mouse-ftc
#      import: app/west.yml
#    - name: zmk
#      remote: infused-kim
#      revision: split-encoder
#      import: app/west.yml      

  self:
    path: config
```
